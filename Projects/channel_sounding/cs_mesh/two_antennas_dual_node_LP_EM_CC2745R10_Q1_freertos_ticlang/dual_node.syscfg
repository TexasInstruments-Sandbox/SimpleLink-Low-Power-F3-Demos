/**
 * @cliArgs --board "/ti/boards/LP_EM_CC2745R10_Q1" --device "CC2745R10RHAQ1" --part "Default" --package "RHA" --rtos "freertos" --product "simplelink_lowpower_f3_sdk@9.14.02.16"
 * @versions {"tool":"1.23.2+4156"}
 */

/**
 * Import the modules used in this configuration.
 */
const FreeRTOS    = scripting.addModule("/freertos/FreeRTOS");
const ble         = scripting.addModule("/ti/ble/ble");
const CCFG        = scripting.addModule("/ti/devices/CCFG");
const rfdesign    = scripting.addModule("/ti/devices/radioconfig/rfdesign");
const AESCCM      = scripting.addModule("/ti/drivers/AESCCM");
const AESCCM1     = AESCCM.addInstance();
const AESCTRDRBG  = scripting.addModule("/ti/drivers/AESCTRDRBG");
const AESCTRDRBG1 = AESCTRDRBG.addInstance();
const AESECB      = scripting.addModule("/ti/drivers/AESECB");
const AESECB1     = AESECB.addInstance();
const ECDH        = scripting.addModule("/ti/drivers/ECDH");
const ECDH1       = ECDH.addInstance();
const GPIO        = scripting.addModule("/ti/drivers/GPIO");
const GPIO1       = GPIO.addInstance();
const GPIO2       = GPIO.addInstance();
const NVS         = scripting.addModule("/ti/drivers/NVS");
const NVS1        = NVS.addInstance();
const Power       = scripting.addModule("/ti/drivers/Power");
const RCL         = scripting.addModule("/ti/drivers/RCL");
const RNG         = scripting.addModule("/ti/drivers/RNG");
const RNG1        = RNG.addInstance();
const UART2       = scripting.addModule("/ti/drivers/UART2", {}, false);
const UART21      = UART2.addInstance();
const Button      = scripting.addModule("/ti/drivers/apps/Button", {}, false);
const Button1     = Button.addInstance();
const Button2     = Button.addInstance();
const Settings    = scripting.addModule("/ti/posix/freertos/Settings");

/**
 * Write custom configuration values to the imported modules.
 */
FreeRTOS.heapSize       = 0x00010000;
FreeRTOS.timerStackSize = 0x00000190;
FreeRTOS.idleStackSize  = 0x00000130;

ble.basicBLE                                        = true;
ble.numOfAdvSets                                    = 1;
ble.maxPDUSize                                      = 255;
ble.disableDisplayModule                            = true;
ble.appExternalControlMode                          = true;
ble.L2CAPCOC                                        = true;
ble.maxRLSize                                       = 6;
ble.maxBonds                                        = 6;
ble.connIntMin                                      = 30;
ble.connIntMax                                      = 30;
ble.scanInt                                         = 1000;
ble.scanDuration                                    = 5000;
ble.dupFilter                                       = "SCAN_FLT_DUP_DISABLE";
ble.connectionMonitorRole                           = true;
ble.channelSounding                                 = true;
ble.csMeasureDistance                               = true;
ble.rangingClient                                   = true;
ble.rangingClientMode                               = 2;
ble.bondPairing                                     = "GAPBOND_PAIRING_MODE_INITIATE";
ble.bondIOCaps                                      = "GAPBOND_IO_CAP_NO_INPUT_NO_OUTPUT";
ble.eccDebugKeys                                    = true;
ble.deviceName                                      = "Dual Node";
ble.deviceRole                                      = "PERIPHERAL_CFG+CENTRAL_CFG";
ble.rangingServer                                   = true;
ble.centraSupTimeout                                = 2000;
ble.numAntennas                                     = 2;
ble.antennasMuxValues                               = 0xC6;
ble.fltPduType                                      = ["SCAN_FLT_PDU_COMPLETE_ONLY","SCAN_FLT_PDU_CONNECTABLE_ONLY","SCAN_FLT_PDU_SCANNABLE_ONLY"];
ble.radioConfig.codeExportConfig.$name              = "ti_devices_radioconfig_code_export_param0";
ble.adcNoiseConfig.codeExportConfig.$name           = "ti_devices_radioconfig_code_export_param1";
ble.bleCsConfig.codeExportConfig.$name              = "ti_devices_radioconfig_code_export_param2";
ble.connUpdateParamsPeripheral.$name                = "ti_ble_general_ble_conn_update_params0";
ble.advSet1.$name                                   = "ti_ble_broadcaster_advertisement_set0";
ble.advSet1.advParam1.$name                         = "ti_ble_broadcaster_advertisement_params0";
ble.advSet1.advParam1.primIntMin                    = 40;
ble.advSet1.advParam1.primIntMax                    = 40;
ble.advSet1.advData1.$name                          = "ti_ble_broadcaster_advertisement_data0";
ble.advSet1.advData1.GAP_ADTYPE_LOCAL_NAME_COMPLETE = true;
ble.advSet1.scanRes1.$name                          = "ti_ble_broadcaster_advertisement_data1";
ble.advSet1.scanRes1.GAP_ADTYPE_LOCAL_NAME_COMPLETE = false;
ble.advSet1.scanRes1.GAP_ADTYPE_POWER_LEVEL         = false;
ble.APULPF3.$name                                   = "ti_drivers_APU0";
ble.connUpdateParamsCentral.$name                   = "ti_ble_general_ble_conn_update_params1";
scripting.suppress("In order to enable multiple antennas, please make sure to enable PBEGPO2 and PBEGPO3 inside TI Drivers -> RCL Observables -> signals", ble, "numAntennas");

CCFG.ccfgTemplate.$name = "ti_devices_CCFG_CCFGCC27XXTemplate0";

AESCCM1.$name = "CONFIG_AESCCM0";

AESCTRDRBG1.$name = "CONFIG_AESCTRDRBG_0";

AESECB1.$name = "CONFIG_AESECB0";

ECDH1.$name = "CONFIG_ECDH0";

GPIO1.$hardware = system.deviceData.board.components.LED_GREEN;
GPIO1.$name     = "CONFIG_GPIO_LED_GREEN";

GPIO2.$hardware = system.deviceData.board.components.LED_RED;
GPIO2.$name     = "CONFIG_GPIO_LED_RED";

NVS1.$name                    = "CONFIG_NVSINTERNAL";
NVS1.internalFlash.$name      = "ti_drivers_nvs_NVSLPF30";
NVS1.internalFlash.regionBase = 0xE5000;
NVS1.internalFlash.regionSize = 0x3000;

Power.policyFunction = "PowerCC27XX_doWFI";

RCL.pbeGpoMask = 0x0C;
RCL.signals    = ["PBEGPO2","PBEGPO3"];

RNG.rngReturnBehavior = "RNG_RETURN_BEHAVIOR_BLOCKING";

RNG1.$name = "CONFIG_RNG_0";

UART21.$name     = "CONFIG_UART2_0";
UART21.$hardware = system.deviceData.board.components.XDS110UART;

Button1.$name     = "CONFIG_BUTTON_0";
Button1.$hardware = system.deviceData.board.components["BTN-1"];

Button2.$name     = "CONFIG_BUTTON_1";
Button2.$hardware = system.deviceData.board.components["BTN-2"];

/**
 * References between modules
 */
CCFG.defaultLfoscCompProfile = null;

/**
 * Pinmux solution for unlocked pins/peripherals. This ensures that minor changes to the automatic solver in a future
 * version of the tool will not impact the pinmux you originally saw.  These lines can be completely deleted in order to
 * re-solve from scratch.
 */
GPIO1.gpioPin.$suggestSolution            = "boosterpack.19";
GPIO2.gpioPin.$suggestSolution            = "boosterpack.36";
RCL.lrfGpio.$suggestSolution              = "LRF";
RCL.lrfGpio.pbegpo2Pin.$suggestSolution   = "boosterpack.6";
RCL.lrfGpio.pbegpo3Pin.$suggestSolution   = "boosterpack.2";
UART21.uart.$suggestSolution              = "UART0";
UART21.uart.dmaTxChannel.$suggestSolution = "DMA_CH2";
UART21.uart.dmaRxChannel.$suggestSolution = "DMA_CH3";
UART21.uart.txPin.$suggestSolution        = "boosterpack.4";
UART21.uart.rxPin.$suggestSolution        = "boosterpack.3";
Button1.button.$suggestSolution           = "boosterpack.30";
Button2.button.$suggestSolution           = "boosterpack.40";
