/**
 * @cliArgs --board "/ti/boards/LP_EM_CC2340R5" --device "CC2340R5RKP" --part "Default" --package "RKP" --rtos "freertos" --product "simplelink_lowpower_f3_sdk@9.11.00.18"
 * @versions {"tool":"1.23.2+4156"}
 */

/**
 * Import the modules used in this configuration.
 */
const FreeRTOS  = scripting.addModule("/freertos/FreeRTOS");
const ADCBuf    = scripting.addModule("/ti/drivers/ADCBuf", {}, false);
const ADCBuf1   = ADCBuf.addInstance();
const GPIO      = scripting.addModule("/ti/drivers/GPIO", {}, false);
const GPIO2     = GPIO.addInstance();
const GPIO4     = GPIO.addInstance();
const LGPTimer  = scripting.addModule("/ti/drivers/LGPTimer", {}, false);
const LGPTimer1 = LGPTimer.addInstance();
const PWM       = scripting.addModule("/ti/drivers/PWM");
const PWM1      = PWM.addInstance();
const Settings  = scripting.addModule("/ti/posix/freertos/Settings");

/**
 * Write custom configuration values to the imported modules.
 */
ADCBuf1.$name                = "CONFIG_ADCBUF_0";
ADCBuf1.adcChannels[0].$name = "CONFIG_ADC_CHANNEL_0";

GPIO2.$hardware = system.deviceData.board.components.LED_GREEN;
GPIO2.$name     = "CONFIG_GPIO_GLED";

GPIO4.$name     = "CONFIG_GPIO_RLED";
GPIO4.$hardware = system.deviceData.board.components.LED_RED;

LGPTimer1.$name         = "CONFIG_LGPTIMER_1";
LGPTimer1.timer.$assign = "LGPT1";

PWM1.$name                            = "CONFIG_PWM_0";
PWM1.timerObject.$name                = "CONFIG_LGPTIMER_0";
PWM1.timerObject.channel2Connection   = "Pin";
PWM1.timerObject.timer.$assign        = "LGPT3";
PWM1.timerObject.timer.ch2Pin.$assign = "boosterpack.10";

const CCFG              = scripting.addModule("/ti/devices/CCFG", {}, false);
CCFG.ccfgTemplate.$name = "ti_devices_CCFG_CCFGCC23X0Template0";

/**
 * Pinmux solution for unlocked pins/peripherals. This ensures that minor changes to the automatic solver in a future
 * version of the tool will not impact the pinmux you originally saw.  These lines can be completely deleted in order to
 * re-solve from scratch.
 */
ADCBuf1.adc.$suggestSolution                       = "ADC";
ADCBuf1.adc.dataDmaChannel.$suggestSolution        = "DMA_CH3";
ADCBuf1.adcChannels[0].adc.$suggestSolution        = "ADC";
ADCBuf1.adcChannels[0].adc.adcPin.$suggestSolution = "boosterpack.28";
GPIO2.gpioPin.$suggestSolution                     = "boosterpack.40";
GPIO4.gpioPin.$suggestSolution                     = "boosterpack.39";
