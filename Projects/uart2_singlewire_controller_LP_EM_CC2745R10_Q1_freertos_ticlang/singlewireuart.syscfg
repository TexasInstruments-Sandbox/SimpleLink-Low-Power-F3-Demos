/**
 * @cliArgs --board "/ti/boards/LP_EM_CC2745R10_Q1" --device "CC2745R10RHAQ1" --part "Default" --package "RHA" --rtos "freertos" --product "simplelink_lowpower_f3_sdk@9.14.00.39"
 * @versions {"tool":"1.23.2+4156"}
 */

/**
 * Import the modules used in this configuration.
 */
const FreeRTOS = scripting.addModule("/freertos/FreeRTOS");
const Display  = scripting.addModule("/ti/display/Display", {}, false);
const Display1 = Display.addInstance();
const GPIO     = scripting.addModule("/ti/drivers/GPIO");
const UART2    = scripting.addModule("/ti/drivers/UART2", {}, false);
const UART21   = UART2.addInstance();
const Button   = scripting.addModule("/ti/drivers/apps/Button", {}, false);
const Button1  = Button.addInstance();
const Button2  = Button.addInstance();
const LED      = scripting.addModule("/ti/drivers/apps/LED", {}, false);
const LED1     = LED.addInstance();
const LED2     = LED.addInstance();
const Settings = scripting.addModule("/ti/posix/freertos/Settings");

/**
 * Write custom configuration values to the imported modules.
 */
Display1.$hardware  = system.deviceData.board.components.XDS110UART;
Display1.$name      = "CONFIG_Display_UART";
Display1.uart.$name = "CONFIG_UART2_0";

const CCFG              = scripting.addModule("/ti/devices/CCFG", {}, false);
CCFG.ccfgTemplate.$name = "ti_devices_CCFG_CCFGCC27XXTemplate0";

UART21.$name                            = "CONFIG_UART2_1";
UART21.txRingBufferSize                 = 1024;
UART21.rxRingBufferSize                 = 1024;
UART21.uart.txPin.$assign               = "boosterpack.7";
UART21.txPinInstance.outputType         = "Open Drain";
UART21.rxPinInstance.mode               = "Output";
UART21.rxPinInstance.outputType         = "Open Drain";
UART21.rxPinInstance.initialOutputState = "High";
UART21.rxPinInstance.pull               = "None";
scripting.suppress("Connected to hardware,@@@.+?@@@ is connected to LaunchPad SPI Bus on the CC2745R10-Q1 Development Platform\\. Consider selecting it in \'use hardware\' above\\. @@@.+?@@@", UART21.uart, "txPin");

Button1.$name     = "CONFIG_BUTTON_0";
Button1.$hardware = system.deviceData.board.components["BTN-1"];

Button2.$name     = "CONFIG_BUTTON_1";
Button2.$hardware = system.deviceData.board.components["BTN-2"];

LED1.$name     = "CONFIG_LED_0";
LED1.$hardware = system.deviceData.board.components.LED_RED;

LED2.$name     = "CONFIG_LED_1";
LED2.$hardware = system.deviceData.board.components.LED_GREEN;

/**
 * References between modules
 */
CCFG.defaultLfoscCompProfile = null;

/**
 * Pinmux solution for unlocked pins/peripherals. This ensures that minor changes to the automatic solver in a future
 * version of the tool will not impact the pinmux you originally saw.  These lines can be completely deleted in order to
 * re-solve from scratch.
 */
Display1.uart.uart.$suggestSolution              = "UART0";
Display1.uart.uart.dmaTxChannel.$suggestSolution = "DMA_CH2";
Display1.uart.uart.dmaRxChannel.$suggestSolution = "DMA_CH3";
Display1.uart.uart.txPin.$suggestSolution        = "boosterpack.4";
Display1.uart.uart.rxPin.$suggestSolution        = "boosterpack.3";
UART21.uart.$suggestSolution                     = "UART1";
UART21.uart.dmaTxChannel.$suggestSolution        = "DMA_CH1";
UART21.uart.dmaRxChannel.$suggestSolution        = "DMA_CH0";
UART21.uart.rxPin.$suggestSolution               = "boosterpack.6";
Button1.button.$suggestSolution                  = "boosterpack.30";
Button2.button.$suggestSolution                  = "boosterpack.40";
LED1.ledPin.$suggestSolution                     = "boosterpack.36";
LED2.ledPin.$suggestSolution                     = "boosterpack.19";
