## Projects/CS_mesh_LP_EM_CC2745R10_Q1_freertos_ticlang/mesh_LP_EM_CC2745R10_Q1_zephyr_gcc/Kconfig
```kconfig
config IMAGE_SWAP_DELAY
    int "Delay in milliseconds between the Bluetooth Mesh message and the image swapping"
    default 1000   # 1 second
    help
        Sets the delay in milliseconds between the Bluetooth Mesh
        message and the image swapping.

source "Kconfig.zephyr"
```
